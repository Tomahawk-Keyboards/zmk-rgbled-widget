## Kconfig
```kconfig
# Color definitions to use with color settings
COLOR_BLACK   := 0
COLOR_RED     := 1
COLOR_GREEN   := 2
COLOR_YELLOW  := 3
COLOR_BLUE    := 4
COLOR_MAGENTA := 5
COLOR_CYAN    := 6
COLOR_WHITE   := 7

config RGBLED_WIDGET
    bool "Enable RGB LED widget for showing battery and output status"
    depends on ZMK_RGB_UNDERGLOW

if RGBLED_WIDGET

config RGBLED_WIDGET_INTERVAL_MS
    int "Minimum wait duration between two blinks in ms"
    default 500

config RGBLED_WIDGET_BOOT_SHOW_BATTERY
    bool "Show battery status during boot"
    default y
    depends on ZMK_BATTERY_REPORTING

config RGBLED_WIDGET_BOOT_SHOW_CONNECTIVITY
    bool "Show connectivity status during boot"
    default y
    depends on ZMK_USB || ZMK_BLE

# Battery level settings

choice RGBLED_WIDGET_BATTERY_SHOW
    prompt "Which battery levels to indicate, non-defaults only work for split centrals"

config RGBLED_WIDGET_BATTERY_SHOW_SELF
    bool "Indicate battery level from self only"

config RGBLED_WIDGET_BATTERY_SHOW_PERIPHERALS
    bool "Indicate battery levels from self and peripherals (if split central)"
    depends on (ZMK_SPLIT && ZMK_SPLIT_ROLE_CENTRAL)
    select ZMK_SPLIT_BLE_CENTRAL_BATTERY_LEVEL_FETCHING

config RGBLED_WIDGET_BATTERY_SHOW_ONLY_PERIPHERALS
    bool "Indicate battery levels from peripherals only (if split central)"
    depends on (ZMK_SPLIT && ZMK_SPLIT_ROLE_CENTRAL)
    select ZMK_SPLIT_BLE_CENTRAL_BATTERY_LEVEL_FETCHING

endchoice

config RGBLED_WIDGET_BATTERY_BLINK_MS
    int "Duration of battery indication in ms"
    default 2000

config RGBLED_WIDGET_BATTERY_FILL_STEP_MS
    int "Battery status pixel fill animation step duration in ms"
    range 1 1000
    default 100

config RGBLED_WIDGET_BATTERY_LEVEL_HIGH
    int "High battery level percentage"
    default 80

config RGBLED_WIDGET_BATTERY_LEVEL_LOW
    int "Low battery level percentage"
    default 20

config RGBLED_WIDGET_BATTERY_LEVEL_CRITICAL
    int "Critical battery level percentage"
    default 5

config RGBLED_WIDGET_BATTERY_COLOR_HIGH
    int "Color for high battery level (above LEVEL_HIGH)"
    range 0 7
    default $(COLOR_GREEN)

config RGBLED_WIDGET_BATTERY_COLOR_MEDIUM
    int "Color for medium battery level (between LEVEL_LOW and LEVEL_HIGH)"
    range 0 7
    default $(COLOR_YELLOW)

config RGBLED_WIDGET_BATTERY_COLOR_LOW
    int "Color for low battery level (below LEVEL_LOW)"
    range 0 7
    default $(COLOR_RED)

config RGBLED_WIDGET_BATTERY_COLOR_CRITICAL
    int "Color for critical battery level (below LEVEL_CRITICAL)"
    range 0 7
    default $(COLOR_RED)

config RGBLED_WIDGET_BATTERY_COLOR_MISSING
    int "Color for battery not detected"
    range 0 7
    default $(COLOR_MAGENTA)

config RGBLED_WIDGET_BATTERY_STATUS_PIXELS
    bool "Use five RGB underglow pixels for battery level"

config RGBLED_WIDGET_BATTERY_STATUS_PIXEL_0
    int "RGB underglow pixel index for the first battery segment"
    default 0

config RGBLED_WIDGET_BATTERY_STATUS_PIXEL_1
    int "RGB underglow pixel index for the second battery segment"
    default 1

config RGBLED_WIDGET_BATTERY_STATUS_PIXEL_2
    int "RGB underglow pixel index for the third battery segment"
    default 2

config RGBLED_WIDGET_BATTERY_STATUS_PIXEL_3
    int "RGB underglow pixel index for the fourth battery segment"
    default 3

config RGBLED_WIDGET_BATTERY_STATUS_PIXEL_4
    int "RGB underglow pixel index for the fifth battery segment"
    default 4

# Connectivity indicator settings
config RGBLED_WIDGET_CONN_BLINK_MS
    int "Duration of BLE connection status blink in ms"
    default RGBLED_WIDGET_OUTPUT_BLINK_MS

config RGBLED_WIDGET_CONN_SHOW_USB
    bool "Show USB indicator instead of BLE status if it has priority"

config RGBLED_WIDGET_CONN_STATUS_PIXEL
    bool "Use a single RGB underglow pixel for connectivity status"

config RGBLED_WIDGET_CONN_STATUS_PIXEL_INDEX
    int "RGB underglow pixel index for connectivity status"
    default 0

config RGBLED_WIDGET_CONN_STATUS_PIXEL_PROFILE_0
    int "RGB underglow pixel index for BLE profile 0 connectivity status"
    default RGBLED_WIDGET_CONN_STATUS_PIXEL_INDEX

config RGBLED_WIDGET_CONN_STATUS_PIXEL_PROFILE_1
    int "RGB underglow pixel index for BLE profile 1 connectivity status"
    default RGBLED_WIDGET_CONN_STATUS_PIXEL_INDEX

config RGBLED_WIDGET_CONN_STATUS_PIXEL_PROFILE_2
    int "RGB underglow pixel index for BLE profile 2 connectivity status"
    default RGBLED_WIDGET_CONN_STATUS_PIXEL_INDEX

config RGBLED_WIDGET_CONN_STATUS_PIXEL_PROFILE_3
    int "RGB underglow pixel index for BLE profile 3 connectivity status"
    default RGBLED_WIDGET_CONN_STATUS_PIXEL_INDEX

config RGBLED_WIDGET_CONN_STATUS_PIXEL_PROFILE_4
    int "RGB underglow pixel index for BLE profile 4 connectivity status"
    default RGBLED_WIDGET_CONN_STATUS_PIXEL_INDEX

config RGBLED_WIDGET_PAIRING_LED
    bool "Blink the blue_led devicetree LED while pairing"
    depends on ZMK_BLE && GPIO
    select LED
    select LED_GPIO
    help
        Blink the LED whose devicetree node label is blue_led while the active BLE profile is
        open. The LED remains active while the keyboard is idle and turns off only when pairing
        ends or the keyboard enters sleep.

config RGBLED_WIDGET_OUTPUT_BLINK_MS  # DEPRECATED, do not use
    int
    default 1000

config RGBLED_WIDGET_CONN_COLOR_CONNECTED
    int "Color for connected BLE connection status"
    range 0 7
    default $(COLOR_BLUE)

config RGBLED_WIDGET_CONN_COLOR_ADVERTISING
    int "Color for advertising BLE connection status"
    range 0 7
    default $(COLOR_YELLOW)

config RGBLED_WIDGET_CONN_COLOR_DISCONNECTED
    int "Color for disconnected BLE connection status"
    range 0 7
    default $(COLOR_RED)

config RGBLED_WIDGET_CONN_COLOR_USB
    int "Color for USB endpoint active"
    range 0 7
    default $(COLOR_CYAN)

# Layer indicator settings
config RGBLED_WIDGET_SHOW_LAYER_CHANGE
    bool "Highlight keys defined on the highest active layer when the layer changes"

config RGBLED_WIDGET_LAYER_BLINK_MS
    int "Duration for layer highlights"
    default 100

config RGBLED_WIDGET_LAYER_COLOR
    int "Color to use for layer highlights"
    range 0 7
    default $(COLOR_CYAN)

config RGBLED_WIDGET_LAYER_DEBOUNCE_MS
    int "Wait duration after a layer change before showing the highest active layer"
    default 100

# Constant layer color settings
config RGBLED_WIDGET_SHOW_LAYER_COLORS
    bool "Use custom colors for layers"

config RGBLED_WIDGET_LAYER_0_COLOR
    int "Color to use for the base layer"
    range 0 7
    default $(COLOR_BLACK)

config RGBLED_WIDGET_LAYER_1_COLOR
    int "Color to use for layer 1"
    range 0 7
    default $(COLOR_RED)

config RGBLED_WIDGET_LAYER_2_COLOR
    int "Color to use for layer 2"
    range 0 7
    default $(COLOR_GREEN)

config RGBLED_WIDGET_LAYER_3_COLOR
    int "Color to use for layer 3"
    range 0 7
    default $(COLOR_YELLOW)

config RGBLED_WIDGET_LAYER_4_COLOR
    int "Color to use for layer 4"
    range 0 7
    default $(COLOR_BLUE)

config RGBLED_WIDGET_LAYER_5_COLOR
    int "Color to use for layer 5"
    range 0 7
    default $(COLOR_MAGENTA)

config RGBLED_WIDGET_LAYER_6_COLOR
    int "Color to use for layer 6"
    range 0 7
    default $(COLOR_CYAN)

config RGBLED_WIDGET_LAYER_7_COLOR
    int "Color to use for layer 7"
    range 0 7
    default $(COLOR_WHITE)

config RGBLED_WIDGET_LAYER_8_COLOR
    int "Color to use for layer 8"
    range 0 7
    default $(COLOR_BLACK)

config RGBLED_WIDGET_LAYER_9_COLOR
    int "Color to use for layer 9"
    range 0 7
    default $(COLOR_BLACK)

config RGBLED_WIDGET_LAYER_10_COLOR
    int "Color to use for layer 10"
    range 0 7
    default $(COLOR_BLACK)

config RGBLED_WIDGET_LAYER_11_COLOR
    int "Color to use for layer 11"
    range 0 7
    default $(COLOR_BLACK)

config RGBLED_WIDGET_LAYER_12_COLOR
    int "Color to use for layer 12"
    range 0 7
    default $(COLOR_BLACK)

config RGBLED_WIDGET_LAYER_13_COLOR
    int "Color to use for layer 13"
    range 0 7
    default $(COLOR_BLACK)

config RGBLED_WIDGET_LAYER_14_COLOR
    int "Color to use for layer 14"
    range 0 7
    default $(COLOR_BLACK)

config RGBLED_WIDGET_LAYER_15_COLOR
    int "Color to use for layer 15"
    range 0 7
    default $(COLOR_BLACK)

config RGBLED_WIDGET_LAYER_16_COLOR
    int "Color to use for layer 16"
    range 0 7
    default $(COLOR_BLACK)

config RGBLED_WIDGET_LAYER_17_COLOR
    int "Color to use for layer 17"
    range 0 7
    default $(COLOR_BLACK)

config RGBLED_WIDGET_LAYER_18_COLOR
    int "Color to use for layer 18"
    range 0 7
    default $(COLOR_BLACK)

config RGBLED_WIDGET_LAYER_19_COLOR
    int "Color to use for layer 19"
    range 0 7
    default $(COLOR_BLACK)

config RGBLED_WIDGET_LAYER_20_COLOR
    int "Color to use for layer 20"
    range 0 7
    default $(COLOR_BLACK)

config RGBLED_WIDGET_LAYER_21_COLOR
    int "Color to use for layer 21"
    range 0 7
    default $(COLOR_BLACK)

config RGBLED_WIDGET_LAYER_22_COLOR
    int "Color to use for layer 22"
    range 0 7
    default $(COLOR_BLACK)

config RGBLED_WIDGET_LAYER_23_COLOR
    int "Color to use for layer 23"
    range 0 7
    default $(COLOR_BLACK)

config RGBLED_WIDGET_LAYER_24_COLOR
    int "Color to use for layer 24"
    range 0 7
    default $(COLOR_BLACK)

config RGBLED_WIDGET_LAYER_25_COLOR
    int "Color to use for layer 25"
    range 0 7
    default $(COLOR_BLACK)

config RGBLED_WIDGET_LAYER_26_COLOR
    int "Color to use for layer 26"
    range 0 7
    default $(COLOR_BLACK)

config RGBLED_WIDGET_LAYER_27_COLOR
    int "Color to use for layer 27"
    range 0 7
    default $(COLOR_BLACK)

config RGBLED_WIDGET_LAYER_28_COLOR
    int "Color to use for layer 28"
    range 0 7
    default $(COLOR_BLACK)

config RGBLED_WIDGET_LAYER_29_COLOR
    int "Color to use for layer 29"
    range 0 7
    default $(COLOR_BLACK)

config RGBLED_WIDGET_LAYER_30_COLOR
    int "Color to use for layer 30"
    range 0 7
    default $(COLOR_BLACK)

config RGBLED_WIDGET_LAYER_31_COLOR
    int "Color to use for layer 31"
    range 0 7
    default $(COLOR_BLACK)

endif # RGBLED_WIDGET

DT_COMPAT_ZMK_BEHAVIOR_RGBLED_WIDGET := zmk,behavior-rgbled-widget

config ZMK_BEHAVIOR_RGBLED_WIDGET
    bool
    default $(dt_compat_enabled,$(DT_COMPAT_ZMK_BEHAVIOR_RGBLED_WIDGET))
```

## dts/bindings/behaviors/zmk,rgbled-widget.yaml
```yaml
description: RGB LED widget indicator behavior

compatible: "zmk,behavior-rgbled-widget"

include: zero_param.yaml

properties:
  indicate-battery:
    type: boolean
  indicate-connectivity:
    type: boolean
  indicate-layer:
    type: boolean
  led-gpios:
    type: phandle-array
    description: |
      Ignored compatibility property for older shield nodes that configured
      discrete GPIO LEDs. The underglow backend uses zmk,underglow instead.
```
